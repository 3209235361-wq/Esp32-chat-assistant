## main/Kconfig.projbuild
```kconfig
menu "Chat Assistant Configuration"

    config APP_WIFI_SSID
        string "WiFi SSID"
        default ""
        help
            Wi-Fi 名称。值保存在 sdkconfig 中，而 sdkconfig 已被 .gitignore
            忽略，因此不会被提交到仓库；修改请运行 idf.py menuconfig。

    config APP_WIFI_PASSWORD
        string "WiFi password"
        default ""
        help
            Wi-Fi 密码。注意：Kconfig 的 string 是明文，密码会出现在
            sdkconfig、sdkconfig.h 和最终固件里，不要用这里的值保护真实
            敏感网络。

    config APP_SERVER_IP
        string "Backend server IP"
        default "172.20.10.3"
        help
            FastAPI 后端地址。手机热点一般是 172.20.10.x。

    config APP_SERVER_PORT
        int "Backend server port"
        default 8006
        range 1 65535

endmenu
```

## sdkconfig.defaults
```kconfig
# 复现本地固件(WiFi 与后端地址仍走 menuconfig,不进仓库)

CONFIG_IDF_TARGET="esp32s3"

# 16 MB flash, DIO @ 80 MHz
CONFIG_ESPTOOLPY_FLASHSIZE_16MB=y
CONFIG_ESPTOOLPY_FLASHMODE_DIO=y
CONFIG_ESPTOOLPY_FLASHFREQ_80M=y

# 8 MB 八线 PSRAM @ 40 MHz —— 录音/播放缓冲都在这里
CONFIG_SPIRAM=y
CONFIG_SPIRAM_MODE_OCT=y
CONFIG_SPIRAM_SPEED_40M=y
CONFIG_SPIRAM_USE_MALLOC=y
CONFIG_SPIRAM_MALLOC_ALWAYSINTERNAL=16384
CONFIG_SPIRAM_MALLOC_RESERVE_INTERNAL=32768

# factory 6 MB + model 2 MB：唤醒词模型放不进默认分区表
CONFIG_PARTITION_TABLE_CUSTOM=y
CONFIG_PARTITION_TABLE_CUSTOM_FILENAME="partitions.csv"

# esp-sr:中文唤醒词「你好小智」+ WebRTC 降噪与 VAD
CONFIG_SR_WN_WN9S_NIHAOXIAOZHI=y
CONFIG_SR_NSN_WEBRTC=y
CONFIG_SR_VADN_WEBRTC=y
CONFIG_SR_MN_CN_NONE=y
CONFIG_SR_MN_EN_NONE=y

# vTaskList() 带核号(内存/栈监控用,两个开关都要开)
CONFIG_FREERTOS_USE_TRACE_FACILITY=y
CONFIG_FREERTOS_USE_STATS_FORMATTING_FUNCTIONS=y
CONFIG_FREERTOS_VTASKLIST_INCLUDE_COREID=y
```
